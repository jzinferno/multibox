## configs/defconfig
```kconfig
# settings
CONFIG_EXTRAVERSION="-jzinferno"
CONFIG_CFLAGS="-Os"
CONFIG_LDFLAGS=""

CONFIG_STATIC=n

# functions
CONFIG_GETENFORCE=y
CONFIG_SELINUXENABLED=y
CONFIG_SETENFORCE=y
```
